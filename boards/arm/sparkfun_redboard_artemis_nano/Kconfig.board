## boards/arm/sparkfun_redboard_artemis_nano/Kconfig.board
```kconfig
# SPDX-License-Identifier: Apache-2.0
#
# Copyright (c) 2023 Ambiq Micro Inc. <www.ambiq.com>

config BOARD_SPARKFUN_REDBOARD_ARTEMIS_NANO
	bool "SparkFun RedBoard Artemis Nano"
	depends on SOC_APOLLO3_BLUE
```
